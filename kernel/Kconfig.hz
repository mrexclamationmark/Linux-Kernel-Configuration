## kernel/Kconfig.hz
```kconfig
# SPDX-License-Identifier: GPL-2.0-only
#
# Timer Interrupt Frequency Configuration
#


choice
	prompt "Timer frequencies"
	default HZ_320
	help
	 Configuration of the timer frequency.
	 Sources:include/linux/jiffies.h
	 Sources:include/asm-generic/param.h

	 Hz formula:
	 1000 / X

	 Complete Hertz Numbers:
	 1, 2, 4, 5, 8, 10, 20, 25, 40, 50, 80, 100, 125, 200, 250,
	 400, 500, 800, 1000

	 Balance between tick rate and number of ticks,
	 with better counter performance than 316Hz,
	 320Hz

	config HZ_320
		bool "320 HZ"
	help
	 320 ticks per second.
	 3.125ms each tick.

endchoice

config HZ
	int
	default 320 if HZ_320

config SCHED_HRTICK
	def_bool HIGH_RES_TIMERS
```
